## conf/distro/icaros-nas.conf
```bitbake
include conf/distro/poky.conf
# Distro Layer configuration
# include and overwrite default poky distro

DISTRO = "icaros-nas"
DISTRO_NAME = "IcarOS Nas lightweight Disto for low end devices "
DISTRO_VERSION = "0.1"
DISTRO_CODENAME = "Guacamole"
SDK_VENDOR = "-icarossdk"
SDK_VERSION = "${DISTRO_VERSION}"
MAINTAINER = "ska@linux.it"

DISTRO_FEATURES:append = " pam"

DISTRO_FEATURES:remove = " opengl"
DISTRO_FEATURES:remove = " wayland"
DISTRO_FEATURES:remove = " x11"
DISTRO_FEATURES:remove = " usbgadget"
DISTRO_FEATURES:remove = " pci"
DISTRO_FEATURES:remove = " bluez5"
DISTRO_FEATURES:remove = " bluetooth"
DISTRO_FEATURES:remove = " wifi"
DISTRO_FEATURES:remove = " alsa"
DISTRO_FEATURES:remove = " pulseaudio"

DISTRO_FEATURES:remove = " pcmcia"
DISTRO_FEATURES:remove = " 3g"
DISTRO_FEATURES:remove = " nfc"
DISTRO_FEATURES:remove = " multiarch"

# Selects sysvinit + initscripts and drops systemd from DISTRO_FEATURES
# (see conf/distro/include/init-manager-sysvinit.inc)
INIT_MANAGER = "sysvinit"
```

## conf/distro/icaros-wayland.conf
```bitbake
# IcarOS Distro for Wayland.
# Using the downstream kernel flavour.

require conf/distro/include/icaros-base.inc

DISTRO = "icaros-wayland"
DISTRO_NAME = "IcarOS Wayland"
DISTRO_FLAVOUR = ""

# we use graphics, so set opengl
DISTRO_FEATURES:append = " opengl"

DISTRO_FEATURES:append = " wayland"
DISTRO_FEATURES:remove = " x11"

# lxqt requires this
DISTRO_FEATURES:append = " polkit"
```

## conf/distro/include/icaros-base.inc
```bitbake
require conf/distro/poky.conf

DISTRO = "icaros-base"
DISTRO_NAME = "IcarOS Distro Base"

ICAROS_BUILDNBR ?= "0"
ICAROS_PURPOSE ?= "Testing"

def get_icaros_prerelease(purpose, datetime):
    if purpose == "Testing":
        return '-devel-%s' % (datetime)
    elif purpose == "Nightly":
        return '-devel-%s' % (datetime[:8])
    elif purpose == "Monthly":
        return '-devel-%s' % (datetime[:6])
    elif purpose == "Release":
        return ''
    else:
        return '-devel-%s' % (datetime)

ICAROS_BUILD ?= "+build.${ICAROS_BUILDNBR}"
ICAROS_MATRIX_BUILD_TIME ?= "${DATETIME}"
ICAROS_MATRIX_BUILD_TIME[vardepsexclude] = "DATETIME"
ICAROS_PRERELEASE ?= "${@get_icaros_prerelease(d.getVar('ICAROS_PURPOSE'), d.getVar('ICAROS_MATRIX_BUILD_TIME'))}"
ICAROS_MAJOR ?= "1"
ICAROS_MINOR ?= "0"
ICAROS_PATCH ?= "0"
ICAROS_RELEASE ?= "${ICAROS_MAJOR}.${ICAROS_MINOR}.${ICAROS_PATCH}"

# IcarOS version number without date, for U-Boot/Kernel and other
# IcarOS specific software artifacts.
ICAROS_VERSION ?= "${ICAROS_RELEASE}${@'' if d.getVar('ICAROS_PURPOSE') == 'Release' else '-devel'}"

# Complete image version with date and build number
DISTRO_VERSION = "${ICAROS_RELEASE}${ICAROS_PRERELEASE}${ICAROS_BUILD}"

SDK_VENDOR = "-icarossdk"
SDK_NAME_PREFIX = "${DISTRO}"
# do not use elements in SDK_VERSION which are in vardepsexclude
SDK_VERSION = "${ICAROS_RELEASE}"

MAINTAINER = "ska@linux.it"

TARGET_VENDOR = "-icaros"

DISTROOVERRIDES .= ":icaros-distro"

# create etc/build in the rootfs
INHERIT += "image-buildinfo"

# Log information on images and packages
INHERIT += "buildhistory"
BUILDHISTORY_COMMIT = "1"

IMAGE_LINGUAS ?= "en-us"

ERROR_QA:remove = "version-going-backwards"

DISTRO_FEATURES:append = " pam usrmerge tpm2"
DISTRO_FEATURES:remove = "ptest"

# Selects systemd and drops sysvinit from DISTRO_FEATURES
# (see conf/distro/include/init-manager-systemd.inc)
INIT_MANAGER = "systemd"
```
